## prj.conf
```kconfig
# Logging 
CONFIG_LOG=y
CONFIG_LOG_PRINTK=y

# Activate SIT core library
CONFIG_SIT=y

#Activate SIT_LED
CONFIG_SIT_LED=y

# Activate SIT_BLE
CONFIG_SIT_BLE=y

# Activate Bluetooth 
CONFIG_BT=y
CONFIG_BT_DEBUG_LOG=y
CONFIG_BT_SMP=y
CONFIG_BT_SIGNING=y
CONFIG_BT_PERIPHERAL=y
CONFIG_BT_DIS=y
CONFIG_BT_ATT_PREPARE_COUNT=5
CONFIG_BT_BAS=y
CONFIG_BT_PRIVACY=y
CONFIG_BT_DEVICE_NAME="DWM3001"
CONFIG_BT_DEVICE_APPEARANCE=833
CONFIG_BT_DEVICE_NAME_DYNAMIC=y
CONFIG_BT_DEVICE_NAME_MAX=65

CONFIG_BT_KEYS_OVERWRITE_OLDEST=y
CONFIG_BT_SETTINGS=y
CONFIG_FLASH=y
CONFIG_FLASH_PAGE_LAYOUT=y
CONFIG_FLASH_MAP=y
CONFIG_NVS=y
CONFIG_SETTINGS=y
```

## src/main.c
```c
/**
 * Copyright (c) 2015 - Decawave Ltd, Dublin, Ireland.
 * Copyright (c) 2022 - Sven Hoyer
 * 
 * This is an Simple Bluetooth Low Energy Example for the 
 * DWM1001-DEV Board Zephyr
 */
#include <zephyr/sys/printk.h>
#include <zephyr/kernel.h>

#include <sit_led/sit_led.h>
#include <sit_ble/ble_device.h>

#define APP_NAME "SIMPLE BLE EXAMPLE\n"

void main(void) {
	printk(APP_NAME);
	printk("==================\n");

	sit_led_init();
	ble_device_init();

	
	/* Implement notification. At the moment there is no suitable way
	 * of starting delayed work so we do it here
	 */
	while (1) {
		k_sleep(K_SECONDS(1));

		if (is_connected()) {
			/* Battery level simulation */
			bas_notify();

			sit_set_led(1, 0);
		} else {
			/* Toggle LED while disconnect */
			sit_toggle_led(1);
		}
		
	}
}
```
